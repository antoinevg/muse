# musesoc register map
Vendor: amaranth-soc
TODO device.description
Registers are 32-bit, read-write, reset 0x0 unless marked. A register's access mark holds for its fields unless they carry their own. Offsets are from the block's base; lines under a group give offsets from that group; [hi:lo] are bit positions; {n}, {i} and the like mark numbered series; 'fields as' and 'values as' point back to an identical list; <NAME> marks a mode.

## Memory map
0x80000000 UART size 0x40
0x80000040 LEDS size 0x8
0x80000060 PMOD0 size 0x20
0x80000080 PMOD1 size 0x8
0x80001000 TIMER size 0x20

## Interrupts
0 timer (TIMER)
1 uart (UART)

## Further device data
memoryRegions:
  BOOTROM baseAddress=0x00000000 size=0x00004000
  SCRATCHPAD baseAddress=0x00004000 size=0x00001000
  INTERNAL_SRAM baseAddress=0x40000000 size=0x00010000

## TIMER
Base 0x80001000
0x00 reload — timer reload register
  [31:0] reload — timer reload register field
0x04 en — timer en register
  [0] en — timer en register field
0x08 ctr — timer ctr register
  [31:0] ctr — timer ctr register field
0x10 ev_status ro — timer ev_status register
  [0] status — timer status register field
0x14 ev_pending — timer ev_pending register
  [0] pending — timer pending register field
0x18 ev_enable — timer ev_enable register
  [0] enable — timer enable register field

## UART
Base 0x80000000
0x00 divisor — uart divisor register
  [7:0] divisor — uart divisor register field
0x04 rx_data ro — uart rx_data register
  [7:0] rx_data — uart rx_data register field
0x08 rx_rdy ro — uart rx_rdy register
  [0] rx_rdy — uart rx_rdy register field
0x0C rx_err ro — uart rx_err register
  [2:0] rx_err — uart rx_err register field
0x10 tx_data wo — uart tx_data register
  [7:0] tx_data — uart tx_data register field
0x14 tx_rdy ro — uart tx_rdy register
  [0] tx_rdy — uart tx_rdy register field
0x20 ev_status ro — uart ev_status register
  [2:0] status — uart status register field
0x24 ev_pending — uart ev_pending register
  [2:0] pending — uart pending register field
0x28 ev_enable — uart ev_enable register
  [2:0] enable — uart enable register field

## LEDS
Base 0x80000040
0x00 output wo — leds output register
  [7:0] output — leds output register field

## PMOD0
Base 0x80000060
0x00 mode — pmod0 mode register
  [13:0] mode — pmod0 mode register field
0x08 csr_r ro — pmod0 csr_r register
  [13:0] csr_r — pmod0 csr_r register field
0x10 csr_w wo — pmod0 csr_w register
  [13:0] csr_w — pmod0 csr_w register field

## PMOD1
Base 0x80000080
0x00 csr — pmod1 csr register
  [7:0] csr — pmod1 csr register field
